## Kconfig
```kconfig
#
# apps/system/mqjs/Kconfig — NSH builtin registration for the mquickjs
# `js` command (tree-in OpenVela port of mquickjs-rs; see SYNC.md).
#

config MQJS_JS
	bool "mquickjs JS interpreter (mquickjs-rs OpenVela port)"
	default n
	---help---
		Run JS scripts under the NSH shell with the mquickjs engine
		(RIDL-variant stdlib; console served by the Rust adapter when
		MQJS_RS is enabled). Usage: js <script.js> [...]

if MQJS_JS

config MQJS_RS
	bool "Rust adapter bridge (RIDL stdlib console)"
	default y
	---help---
		Build the vendored Rust adapter (apps/system/mqjs/rust, host
		cargo) and link its staticlib from apps/staging. The adapter
		owns JS context creation/eval/free (the RIDL glue dispatches
		through the JSContext user_data that only the Rust side
		installs) and serves the console singleton.
		When disabled, the C-only checkpoint form is built instead
		(js_main_c.c: direct C context creation/eval plus C fallback
		stubs for the adapter-owned stdlib entry points; console
		prints to stdout). Used as the QEMU arm64 C checkpoint
		(Phase 3.3) to isolate engine/defconfig domain issues from
		Rust domain issues.

config MQJS_JS_PROGNAME
	string "Program name"
	default "js"

config MQJS_JS_PRIORITY
	int "Priority"
	default 100

config MQJS_JS_STACKSIZE
	int "Stack size (bytes)"
	default 65536
	---help---
		The engine's recursive parser needs headroom; the NSH builtin
		default stack (KB-level) is not enough. 64 KiB minimum.

endif

if MQJS_JS

source "$APPSDIR/system/mqjs/lvgldemo/Kconfig"

endif # MQJS_JS
```

## lvgldemo/Kconfig
```kconfig
#
# apps/system/mqjs/lvgldemo/Kconfig — B0 spike 宿主 app：mquickjs-ui
# （RIDL Label/Button）+ LVGL 端到端演示（由 ../Kconfig source 进树）。
#

menuconfig MQJS_LVGLDEMO
	bool "mquickjs LVGL UI demo (mqjslvg: mquickjs-ui via RIDL)"
	default n
	depends on MQJS_JS && MQJS_RS && GRAPHICS_LVGL
	---help---
		Build the B0-spike host app: LVGL window + mquickjs engine
		(RIDL aggregate incl. Label/Button from mquickjs-ui) + embedded
		demo JS + one unified loop. The demo exercises the four spike
		risk points (GC-in-callback, same-thread, post-eval callback,
		LV_EVENT_DELETE handle release) and prints MQJS_LVGL sentinels.
		Depends on the mqjs builtin (MQJS_JS+MQJS_RS): the demo links
		libmqjs.a from the mqjs app's Rust adapter build.

if MQJS_LVGLDEMO

config MQJS_LVGLDEMO_PROGNAME
	string "Program name"
	default "mqjslvgl"

config MQJS_LVGLDEMO_PRIORITY
	int "Demo task priority"
	default 100

config MQJS_LVGLDEMO_STACKSIZE
	int "Demo task stack size (bytes)"
	default 131072
	---help---
		JS parser + lv_timer_handler share this stack; 128 KiB mirrors
		the js builtin's headroom policy plus LVGL frames.

endif # MQJS_LVGLDEMO
```
